## package/Config.in
```kconfig
menu "My external packages"
    source "$BR2_EXTERNAL_MY_EXT_PATH/package/foo_cmake/Config.in"
    source "$BR2_EXTERNAL_MY_EXT_PATH/package/mediamtx/Config.in"
endmenu
```

## package/foo_cmake/Config.in
```kconfig
config BR2_PACKAGE_FOO_CMAKE
    bool "foo_cmake"
    depends on BR2_TOOLCHAIN_BUILDROOT_CXX
    help
      Simple test program built with CMake.


comment "foo_cmake needs a toolchain with C++ support"
    depends on !BR2_TOOLCHAIN_BUILDROOT_CXX
```

## package/mediamtx/Config.in
```kconfig
config BR2_PACKAGE_MEDIAMTX
    bool "mediamtx"
    depends on BR2_PACKAGE_HOST_GO_TARGET_ARCH_SUPPORTS
    help
      MediaMTX is a real-time media server and proxy.
```
